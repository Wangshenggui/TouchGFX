; *************************************************************
; *** Scatter-Loading Description File generated by uVision ***
; *************************************************************

LR_IROM1 0x08000000 0x00020000  {    ; load region size_region
  ER_IROM1 0x08000000 0x00020000  {  ; load address = execution address
   *.o (RESET, +First)
   *(InRoot$$Sections)
   
   .ANY (+RO)
  }
  ;RW_IRAM1 0x20000000 0x00020000  {  ; RW data
   ;.ANY (+RW +ZI)
  ;}
  RW_IRAM2 0x24000000 0x00050000  {
   .ANY (+RW +ZI)
  }
}

LR_EROM1 0x90000000 0x00800000  {    ; load region size_region
  extflash.bin 0x90000000 0x00800000  {  ; load address = execution address
  
  
   *.o (ExtFlashSection)  
   *.o (TextFlashSection)
   *.o (FontFlashSection)
   
   ;---------------------------------Application/MDK-ARM
   ;startup_stm32h750xx.o
   
   ;---------------------------------Application/User/Core
   ;main.o
   gpio.o
   ;FreeRTOS.o
   ;adc.o		很奇怪，只能放到内部FLASH，否则运行速度缓慢，甚至开不了机
   crc.o
   ;dma.o
   dma2d.o
   ltdc.o
   spi.o
   ;tim.o
   usart.o
   ;stm32h7xx_it.o
   ;stm32h7xx_hal_cortex.o
   ;stm32h7xx_hal_timebase_TIM.o
   
   ;---------------------------------Drivers/STM32H7xx_HAL_Driver
   stm32h7xx_hal_adc.o
   stm32h7xx_hal_adc_ex.o
   ;stm32h7xx_hal_cortex.o
   stm32h7xx_hal_crc.o
   stm32h7xx_hal_crc_ex.o
   ;stm32h7xx_hal_rcc.o
   stm32h7xx_hal_rcc_ex.o
   stm32h7xx_hal_flash.o
   stm32h7xx_hal_flash_ex.o
   stm32h7xx_hal_gpio.o
   stm32h7xx_hal_hsem.o
   stm32h7xx_hal_dma.o
   stm32h7xx_hal_dma_ex.o
   stm32h7xx_hal_mdma.o
   stm32h7xx_hal_pwr.o
   ;stm32h7xx_hal_pwr_ex.o
   ;stm32h7xx_hal.o
   stm32h7xx_hal_i2c.o
   stm32h7xx_hal_i2c_ex.o
   stm32h7xx_hal_exti.o
   stm32h7xx_hal_dma2d.o
   stm32h7xx_hal_ltdc.o
   stm32h7xx_hal_ltdc_ex.o
   stm32h7xx_hal_spi.o
   stm32h7xx_hal_spi_ex.o
   ;stm32h7xx_hal_tim.o
   ;stm32h7xx_hal_tim_ex.o
   stm32h7xx_hal_uart.o
   stm32h7xx_hal_uart_ex.o
   
   ;---------------------------------Drivers/CMSIS
   ;system_stm32h7xx.o
   
   ;---------------------------------APP
    ;sdram.o
    ctiic.o
	ft5206.o
	w25qxx.o
	spi2.o
	24cxx.o
	myiic.o
	;ftl.o
	;nand.o
	;nandtester.o
	my_adc.o
	bmp.o
	;sdmmc_sdcard.o
	
	;---------------------------------SYSTEM
	;sys.o
	delay.o
   usart_it.o
	;tim_it.o
	
	;---------------------------------MALLOC
   malloc.o
	
	;---------------------------------FatFs
   ff.o
   sdio.o
   cc936.o
   myFatFs.o
	
	;---------------------------------USB_CORE
	usbd_core.o
	usbd_ctlreq.o
	usbd_ioreq.o
	
	;---------------------------------USB_DEVICE
	usbd_msc.o
	usbd_msc_bot.o
	usbd_msc_data.o
	usbd_msc_scsi.o
	
	;---------------------------------USB_APP
	usbd_conf.o
	usbd_desc.o
	usbd_storage.o
	
	;---------------------------------USB_HAL
	stm32h7xx_hal_pcd.o
	stm32h7xx_hal_pcd_ex.o
	stm32h7xx_ll_usb.o
	
	;---------------------------------DriverLayer
   Backlight.o
   Voice.o
   Radio.o
	
	;---------------------------------Application/User/TouchGFX/target
   TouchGFXHAL.o
   STM32TouchController.o
   TouchGFXGPIO.o
   
   ;---------------------------------Application/User/TouchGFX/target/generate
   ;TouchGFXConfiguration.o
   TouchGFXGeneratedHAL.o
   ;STM32DMA.o
   OSWrappers.o
   
   ;---------------------------------Application/User/TouchGFX/App
   app_touchgfx.o
   
   ;---------------------------------Middlewares/FreeRTOS
   croutine.o
   event_groups.o
   list.o
   queue.o
   stream_buffer.o
   task.o
   timers.o
   cmsis_os.o
   heap_4.o
   ;;port.o
   
   ;tasks.o
   
   ;---------------------------------gui
   BookStarContainer.o
   BookStarContainerBase.o
   
   bootscreenpresenter.o
   bootscreenview.o
	bootScreenViewBase.o
	
	desktopscreenpresenter.o
	desktopscreenview.o
	desktopscreenviewbase.o
	
	FileManagerContainer.o
	FileManagerContainerBase.o
	
	FileManagerScreenPresenter.o
	FileManagerScreenView.o
	FileManagerScreenViewBase.o
	
	FrontendApplication.o
	FrontendApplicationBase.o
	
	GridContainer.o
   GridContainerBase.o
   
   ;Model.o
   
   NavigationBarContainer.o
   NavigationBarContainerBase.o
   
   NotificationBarContainer.o
   NotificationBarContainerBase.o
   
   PaddySowingScreenPresenter.o
   PaddySowingScreenView.o
   PaddySowingScreenViewBase.o
   
   SeedContainer.o
   SeedContainerBase.o
   
   SettingScreenPresenter.o
   SettingScreenView.o
	settingscreenviewbase.o
	
	StatusBarContainer.o
	StatusBarContainerBase.o
	
	KeyBoardContainer.o
	KeyBoardContainerBase.o
	
   ;;---------------------------------generated
   ApplicationFontProvider.o
   BitmapDatabase.o
   CachedFont.o
   FontCache.o
   FrontendApplicationBase.o
   ;GeneratedFont.o
   Texts.o
   ;TypedTextDatabase.o
   UnmappedDataFont.o
   
   kerning_verdana_20_1bpp.o
   
   
   ;;---------------------------------Lib
   touchgfx_core.o
   
   
   ;---------------------------------包含C标准库
   stdio.o
   stdlib.o
   string.o
   cassert.o
   stdarg.o
   stdint.o
   new.o
   cstring.o
   stddef.o
   reent.o
   stdarg.o
   assert.o
   csignal.o
   
   
   gui/containers/T9_Input.o
   gui/containers/T9_InputMb.o
   T9_InputMb.o
   t9_input.o
   
   PinYinScreen.o
   
   
   
   USBInterconnectionScreenView.o
   USBInterconnectionScreenViewBase.o
   
   SlaveControlScreenView.o
   SlaveControlScreenViewBase.o
   
   KeyBoardContainer.o
   KeyBoardContainerBase.o
   
   RTKConfigurationScreenView.o
   RTKConfigurationScreenViewBase.o
   
   Screen_4GModuleSetupView.o
   Screen_4GModuleSetupViewBase.o
   
   Setup4GContainer1.o
   Setup4GContainer2.o
   
   Setup4GContainer1Base.o
   Setup4GContainer2Base.o
   
   MusicScreenView.o
   MusicScreenViewBase.o
   
   image.o
   bitmap.o
   texturemaptypes.o
   texturemapper.o
   
   
   
   usmart.o
   usmart_config.o
   usmart_str.o
   usmart_cmd_input.o
   
   screen.o
   listlayout.o
   canvas.o
   scrollbase.o
   tiledimage.o
   radiobutton.o
   
   button.o
   buttonWithLabel.o
   buttonWithIcon.o
   toggleButton.o
   radioButton.o
   repeatButton.o
   flexButton.o
   DynamicGraph.o
   BoxProgress.o
   
   
   
   drawablelist.o
   textprovider.o
   graphlabels.o
   line.o
   outline.o
   scrollwheelwithselectionstyle.o
   abstractdatagraph.o
   ;tasks.o
   
   radiosscom_screenview.o
   radiosscom_screenviewbase.o
   
   
   
   InfoNES_System.o
   rom.o
   InfoNES_pAPU.o
   InfoNES_Mapper.o
   InfoNES.o
   K6502.o
   
   NESScreenView.o
   NESScreenViewBase.o
   NESScreenPresenter.o
   NESContainer.o
   NESContainerBase.o
   
   
   MotionTrailScreenView.o
   MotionTrailScreenViewBase.o
   MotionTrailScreenPresenter.o
   
   CoordinateDotContainerBase.o
   CoordinateDotContainer.o
   CoordinateDotContainerPresenter.o
   
   gui/containers/CoordinateConversion.o
   
   BitmapDatabase.o
   
   arm_math.o
   
   ShellLikeScreenView.o
   ShellLikeScreenViewBase.o
   ShellLikeScreenPresenter.o
   
   
   stm32h7xx_hal_rtc_ex.o
   stm32h7xx_hal_rtc.o
   
   
   coordinateconversion.o
   particleeffect.o
   ;table_misansvf_30_1bpp.o
   
   scrollingmenu.o
   scrollingwheel.o
   touchforwarder.o
   sparsecontainerlist.o
   particlesscrollingwheel.o
   radiosscom_screenpresenter.o
   slavecontrolscreenpresenter.o
   screen_4gmodulesetuppresenter.o
   rtkconfigurationscreenpresenter.o
   usbinterconnectionscreenpresenter.o
   
   model.o
   digitalclock.o
   scalableimage.o
  }
}



